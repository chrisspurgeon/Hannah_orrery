/*

Arduino program to drive a servo motor indicating when Mars is above the horizon in Seattle Washington (122°20'13.2''W, 47°36'32.0''N).
The time is in Pacific Standard Time (PST).

Do NOT adjust the time for daylight savings time! Always set it for standard time.

This code is available at https://github.com/chrisspurgeon/Hannah_orrery


*/





#include "String.h"
#include "Wire.h"
#include "Servo.h"
#include <avr/pgmspace.h>


#define DS1307_I2C_ADDRESS 0x68
#define ledPin 13

int lastSecond = 0;
int pos = 0;
int UP = 170;
int DOWN = 95;

Servo myservo;

long convertedDate;
long lastEvent;
unsigned long horizonTimeLong;

int marsLength = 2326;    //    This is the number of data entries in the mars array below;

int MARS = 0;


// The data entries below capture when Mars dips below the horion and when it rises above the horizon.
// Each entry is in two consecutive parts. The first is a time stamp in this format: YYMMDDHHMM. 
// So if Mars rises on July 4th, 2012 at 9:42AM, the entries would look like this...
//                                          1207040942, 1,

PROGMEM prog_uint32_t mars[]={
1204280305, 0, 1204281319, 1, 1204290300, 0, 1204291316, 1, 1206010106, 0, 
1206011203, 1, 1206020102, 0, 1206021202, 1, 1206030059, 0, 1206031200, 1, 
1206040056, 0, 1206041159, 1, 1206050053, 0, 1206051157, 1, 1206060049, 0, 
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1312301206, 0, 1312310026, 1, 1312311203, 0
};


int checker(long DATE) {
    int currentValue = 0;
    for (int i=0; i < marsLength; i = i + 2) {
        horizonTimeLong = pgm_read_dword_near(mars + i);
        if (horizonTimeLong <= DATE) {
            lastEvent = horizonTimeLong;
            currentValue = pgm_read_dword_near(mars + i + 1);
        }
    }
    Serial.print("Last event was  ");
    Serial.println(lastEvent);
    return currentValue;

}

// Convert normal decimal numbers to binary coded decimal
byte decToBcd(byte val)
{
    return ( (val/10*16) + (val%10) );
}

// Convert binary coded decimal to normal decimal numbers
byte bcdToDec(byte val)
{
    return ( (val/16*10) + (val%16) );
}

// Convert binary coded decimal to normal decimal numbers
long bcdToLong(byte val)
{
    return ( (val/16*10) + (val%16) );
}



// Gets the date and time from the ds1307
void getDateDs1307(long *second,
long *minute,
long *hour,
long *dayOfWeek,
long *dayOfMonth,
long *month,
long *year)
{

    // Reset the register pointer
    Wire.beginTransmission(DS1307_I2C_ADDRESS);
    Wire.write(0);
    Wire.endTransmission();
    Wire.requestFrom(DS1307_I2C_ADDRESS, 7);

    // A few of these need masks because certain bits are control bits
    *second     = bcdToLong(Wire.read() & 0x7f);
    *minute     = bcdToLong(Wire.read());
    *hour       = bcdToLong(Wire.read() & 0x3f);  // Need to change this if 12 hour am/pm
    *dayOfWeek  = bcdToLong(Wire.read());
    *dayOfMonth = bcdToLong(Wire.read());
    *month      = bcdToLong(Wire.read());
    *year       = bcdToLong(Wire.read());
}




void setup() {


    myservo.attach(9);

    delay(5000);

    pinMode(ledPin, OUTPUT);
    Serial.begin(9600); 
    Wire.begin();
    Serial.println("Starting...");

    myservo.write(DOWN);
    Serial.println("Servo should be DOWN");
    delay(2000);
    myservo.write(UP);
    Serial.println("Servo should be at UP");
    delay(2000);
    myservo.write(DOWN);
    Serial.println("Servo should be at DOWN");
    delay(2000);
    myservo.write(UP);
    Serial.println("Servo should be at UP");
    delay(2000);
    myservo.write(DOWN);
    Serial.println("Servo should be at DOWN");
    delay(2000);



}

void loop() {

    long second, minute, hour, dayOfWeek, dayOfMonth, month, year;

    getDateDs1307(&second, &minute, &hour, &dayOfWeek, &dayOfMonth, &month, &year);

    Serial.print(hour, DEC);
    Serial.print(":");
    if (minute < 10) {
        Serial.print("0");
    }
    Serial.print(minute, DEC);
    Serial.print(":");
    if (second < 10) {
        Serial.print("0");
    }
    Serial.print(second, DEC);
    Serial.print("  ");
    Serial.print(month, DEC);
    Serial.print("/");
    if (dayOfMonth < 10) {
        Serial.print("0");
    }
    Serial.print(dayOfMonth, DEC);
    Serial.print("/");
    Serial.print(year + 2000, DEC);
    Serial.print("  Day_of_week:");
    Serial.println(dayOfWeek, DEC);

    //7 12 16 33

    convertedDate = year * 100000000;
    convertedDate = convertedDate + (month * 1000000);
    convertedDate = convertedDate + (dayOfMonth * 10000);
    convertedDate = convertedDate + (hour * 100);
    convertedDate = convertedDate + (minute);
    Serial.print("Current time is ");
    Serial.println(convertedDate);


    MARS = checker(convertedDate);
    
    Serial.print("I think Mars should be ");
    Serial.println(MARS);
    Serial.println();
    
    if (MARS == 0) {
        myservo.write(DOWN);
    } 
    else {
        myservo.write(UP);
    }

    delay(5000);

}



